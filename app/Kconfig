## app/Kconfig
```kconfig
source "Kconfig.zephyr"
menuconfig LED_SUBSYSTEM
    bool "LED Subsystem"
    default y

if LED_SUBSYSTEM

choice BLINK_SLEEP_TIME
    prompt "LED blink sleep time"
    default BLINK_1S

    config BLINK_500MS
        bool "500ms (fast)"

    config BLINK_1S
        bool "1s (medium)"

    config BLINK_2S
        bool "2s (slow)"
endchoice

menuconfig ADVANCED_LED_SETTINGS
    bool "Advanced LED settings"

if ADVANCED_LED_SETTINGS

config LED_BRIGHTNESS
    int "LED brightness (0-100)"
    range 0 100
    default 100

config LED_FADE_DURATION
    int "LED fade duration (ms)"
    default 500

menu "Expert settings"

config ENABLE_LED_DEBUGGING
    bool "Enable LED debugging"

config CUSTOM_BLINK_PATTERN
    bool "Custom blink pattern"

endmenu

endif
endif
```
